## yocto/meta-dotnet-os/conf/distro/dotnet-os.conf
```bitbake
DISTRO = "dotnet-os"
DISTRO_NAME = "Dotnet Linux"

require conf/distro/poky.conf

# Hardware features 
MACHINE_FEATURES += "wifi bluetooth"

# Extra image configuration defaults
IMAGE_FEATURES ?= "ssh-server-openssh"

# Software features shipped 
DISTRO_FEATURES:append = " wifi bluetooth"

# Set default timezone
DEFAULT_TIMEZONE = "America/Los_Angeles"

# Enable systemd
INIT_MANAGER = "systemd"

# Enable wic format for flashing to sdcard
IMAGE_FSTYPES = "wic"

# Increase the size of root file system 512MB
IMAGE_ROOTFS_EXTRA_SPACE = "256"

# Enable u-boot kernel image
RPI_USE_U_BOOT = "1"

# Set hostname
hostname:pn-base-files = "dnos"

# Set locale
GLIBC_GENERATE_LOCALES = "en_US.UTF-8"
IMAGE_LINGUAS = "en-us"

# Set boot delay to not wait after loading GPU
BOOT_DELAY = "0"
BOOT_DELAY_MS = "0"
UBOOT_NO_DELAY = "1"

# Enable UART console
ENABLE_UART = "1"

# Enable I2C interface
ENABLE_I2C = "1"
KERNEL_MODULE_AUTOLOAD:rpi += "i2c-dev"

# Enable SPI interface
ENABLE_SPI_BUS = "1"

# Enable USB HOST interface
ENABLE_DWC2_HOST = "1"

# Comment this line to disable SSH-ing into target as root 
# EXTRA_IMAGE_FEATURES += "allow-root-login"
```
